## config/west.yml
```yaml
manifest:
  remotes:
    - name: zmkfirmware
      url-base: https://github.com/zmkfirmware
    - name: zmkfirmware-mouse
      url-base: https://github.com/ftc
  projects:
    - name: zmk
      remote: zmkfirmware-mouse
      revision: mouse-ftc
      import: app/west.yml
  self:
    path: config
```
